#include <behaviors.dtsi>
#include <dt-bindings/zmk/bt.h>
#include <dt-bindings/zmk/keys.h>
#include <dt-bindings/zmk/keys.h>

#define DEF 0
#define LWR 1
#define RSE 2
#define ADJ 3

flavor = "balanced";

tapping-term-ms {
    = <300>;};
 };
 };

/

    conditional_layers {
        compatible = "zmk,conditional-layers";

        tri-layer {
            if-layers = <2 1>;
            then-layer = <3>;
        };
    };

    keymap {
        compatible = "zmk,keymap";

        default_layer {
            bindings = <
&mt ESC GRAVE  &kp Z           &kp Y           &kp U             &kp A             &kp Q          &kp P        &kp B                &kp M              &kp L            &kp F            &kp J
&kp TAB        &mt LEFT_GUI C  &mt LEFT_ALT S  &mt LEFT_SHIFT I  &mt LCTRL E       &kp O          &kp D        &mt RIGHT_CONTROL T  &mt RIGHT_SHIFT N  &mt RIGHT_ALT R  &mt RIGHT_GUI H  &kp MINUS
&kp BACKSLASH  &kp V           &kp X           &kp LEFT_BRACKET  &kp SINGLE_QUOTE  &kp SEMICOLON  &kp W        &kp G                &kp COMMA          &kp DOT          &kp K            &kp RS(MINUS)
                                               &kt SLASH         &lt 1 LG(V)       &lt 2 RET      &lt 1 SPACE  &lt 2 BSPC           &kt BACKSPACE
            >;
        };

        lower_layer {
            bindings = <
&kt F1          &mt F1 NUMBER_1   &mt F2 NUMBER_2   &mt F3 NUMBER_3   &mt F4 NUMBER_4      &mt F5 N5              &mt F6 NUMBER_6   &mt F7 NUMBER_7    &mt F8 NUMBER_8   &mt F9 NUMBER_9   &mt F10 NUMBER_0  &kp F11
&mt LCTRL PLUS  &kp LS(NUMBER_1)  &kp LS(NUMBER_2)  &kp LS(NUMBER_3)  &kp LS(NUMBER_4)     &kp LS(N5)             &kp LS(NUMBER_6)  &kp LS(NUMBER_7)   &kp LS(N8)        &kp LS(N8)        &kp LS(NUMBER_9)  &kt LS(BACKSLASH)
&mt LALT EQUAL  &kp N1            &kp N2            &kp N3            &kp LS(NON_US_HASH)  &kp LS(RIGHT_BRACKET)  &kp NON_US_HASH   &kp RIGHT_BRACKET  &kp RA(NUMBER_8)  &kp RA(NUMBER_9)  &kp RA(MINUS)     &kp RALT
                                                    &trans            &trans               &trans                 &trans            &trans             &trans
            >;
        };

        raise_layer {
            bindings = <
&mt LGUI KP_NUM  &kp KP_SLASH     &kp KP_N7  &kp KP_N8  &kp KP_N9          &kp KP_MINUS  &kp C_VOL_UP  &kp HOME  &kp UP           &kp PG_UP  &kp SLCK         &kp CLCK
&mt LCTRL EQUAL  &kp KP_MULTIPLY  &kp KP_N4  &kp KP_N5  &kp KP_N6          &kp KP_PLUS   &kp C_MUTE    &kp LEFT  &kp DOWN         &kp RIGHT  &kp INS          &mt RCTRL K_APP
&kp LALT         &kp KP_N0        &kp KP_N1  &kp KP_N2  &kp KP_N3          &kp KP_DOT    &kp C_VOL_DN  &kp END   &kp PRINTSCREEN  &kp PG_DN  &kp PAUSE_BREAK  &kp RALT
                                             &trans     &kp K_APPLICATION  &trans        &trans        &trans    &trans
            >;
        };

        adjust_layer {
            bindings = <
&bootloader  &none         &none         &none         &none         &none         &none         &none         &none         &none         &none         &bootloader
&bt BT_CLR   &bt BT_SEL 0  &bt BT_SEL 1  &bt BT_SEL 2  &bt BT_SEL 3  &bt BT_SEL 4  &bt BT_SEL 4  &bt BT_SEL 3  &bt BT_SEL 2  &bt BT_SEL 1  &bt BT_SEL 0  &bt BT_CLR
&sys_reset   &none         &none         &none         &none         &none         &none         &none         &none         &none         &none         &sys_reset
                                         &trans        &none         &trans        &none         &trans        &trans
            >;
        };
    };
};
